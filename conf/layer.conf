## conf/layer.conf
```bitbake
BBFILE_COLLECTIONS += "oe-layersetup"
BBFILE_PATTERN_oe-layersetup := "^${LAYERDIR}/"
LAYERVERSION_oe-layersetup = "1"
LAYERSERIES_COMPAT_oe-layersetup = "kirkstone scarthgap styhead walnascar whinlatter"
```
